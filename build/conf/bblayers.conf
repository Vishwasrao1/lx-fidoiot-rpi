## build/conf/bblayers.conf
```bitbake
# POKY_BBLAYERS_CONF_VERSION is increased each time build/conf/bblayers.conf
# changes incompatibly
POKY_BBLAYERS_CONF_VERSION = "2"

BBPATH = "${TOPDIR}"
BSPDIR := "${TOPDIR}/.."
BBFILES ?= ""

BBLAYERS ?= " \
  ${BSPDIR}/poky/meta \
  ${BSPDIR}/poky/meta-poky \
  ${BSPDIR}/poky/meta-yocto-bsp \
  ${BSPDIR}/meta-openembedded/meta-oe \
  ${BSPDIR}/meta-openembedded/meta-perl \
  ${BSPDIR}/meta-openembedded/meta-python \
  ${BSPDIR}/meta-openembedded/meta-networking \
  ${BSPDIR}/meta-openembedded/meta-multimedia \
  ${BSPDIR}/meta-openembedded/meta-filesystems \
  ${BSPDIR}/meta-raspberrypi \
  ${BSPDIR}/meta-swupdate \
  ${BSPDIR}/meta-swupdate-boards \
  ${BSPDIR}/meta-lx-fdo \
  "
```

## meta-lx-fdo/conf/layer.conf
```bitbake
# We have a conf and classes directory, add to BBPATH
BBPATH .= ":${LAYERDIR}"

# We have recipes-* directories, add to BBFILES
BBFILES += "${LAYERDIR}/recipes-*/*/*.bb \
            ${LAYERDIR}/recipes-*/*/*.bbappend"


BBFILE_COLLECTIONS += "meta-lx-fdo"
BBFILE_PATTERN_meta-lx-fdo = "^${LAYERDIR}/"
BBFILE_PRIORITY_meta-lx-fdo = "8"

LAYERDEPENDS_meta-lx-fdo = "core swupdate"
LAYERSERIES_COMPAT_meta-lx-fdo = "warrior dunfell zeus kirkstone"
```
